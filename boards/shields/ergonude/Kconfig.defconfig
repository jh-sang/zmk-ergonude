## boards/shields/ergonude/Kconfig.defconfig
```kconfig
if SHIELD_ERGONUDE

config ZMK_KEYBOARD_NAME
    default "ergonude"
      
endif

menuconfig GPIO_CUSTOM
    bool "Custom GPIO configuration for P0.05 fix"
    default y
    help
      Enable custom GPIO configuration to fix P0.05 pin as matrix row input

if GPIO_CUSTOM

config GPIO_CUSTOM_DEBUG
    bool "Enable debug output for GPIO custom"
    default n
    help
      Enable debug logging for the GPIO custom module

endif
```

## config/dts/bindings/behaviors/zmk,behavior-rgb-ug-solid-breathing.yaml
```yaml
description: RGB Underglow Solid/Breathing Toggle Behavior

compatible: "zmk,behavior-rgb-ug-solid-breathing"

properties:
  "#binding-cells":
    type: int
    const: 0
  label:
    type: string
```

## modules/dts/bindings/behaviors/zmk,behavior-rgb-ug-solid-breathing.yaml
```yaml
description: RGB Underglow Solid/Breathing Toggle Behavior

compatible: "zmk,behavior-rgb-ug-solid-breathing"

include: [zero-cells.yaml]

properties:
  label:
    type: string
    required: true
```
